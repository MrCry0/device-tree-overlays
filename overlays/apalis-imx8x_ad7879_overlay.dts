// SPDX-License-Identifier: GPL-2.0-or-later OR MIT
/*
 * Copyright 2020-2021 Toradex
 */

// Enable the resistive touch controller (AD7879) on the module

/dts-v1/;
/plugin/;

/ {
	compatible = "toradex,apalis-imx8x";
};

&ad7879_ts {
	status = "okay";
};
